## board/freescale/mx6ullmy/Kconfig
```kconfig
if TARGET_MX6ULL_14X14_MY

config SYS_BOARD
	default "mx6ullmy"

config SYS_VENDOR
	default "freescale"

config SYS_CONFIG_NAME
	default "mx6ullmy"

config SYS_TEXT_BASE
	default 0x87800000
endif
```
